/*
    MIT License

    Copyright (c) 2018, Alexey Dynda

    Permission is hereby granted, free of charge, to any person obtaining a copy
    of this software and associated documentation files (the "Software"), to deal
    in the Software without restriction, including without limitation the rights
    to use, copy, modify, merge, publish, distribute, sublicense, and/or sell
    copies of the Software, and to permit persons to whom the Software is
    furnished to do so, subject to the following conditions:

    The above copyright notice and this permission notice shall be included in all
    copies or substantial portions of the Software.

    THE SOFTWARE IS PROVIDED "AS IS", WITHOUT WARRANTY OF ANY KIND, EXPRESS OR
    IMPLIED, INCLUDING BUT NOT LIMITED TO THE WARRANTIES OF MERCHANTABILITY,
    FITNESS FOR A PARTICULAR PURPOSE AND NONINFRINGEMENT. IN NO EVENT SHALL THE
    AUTHORS OR COPYRIGHT HOLDERS BE LIABLE FOR ANY CLAIM, DAMAGES OR OTHER
    LIABILITY, WHETHER IN AN ACTION OF CONTRACT, TORT OR OTHERWISE, ARISING FROM,
    OUT OF OR IN CONNECTION WITH THE SOFTWARE OR THE USE OR OTHER DEALINGS IN THE
    SOFTWARE.
*/
/**
 *   Nano/Atmega328 PINS: connect LCD to D5 (D/C), D4 (CS), D3 (RES), D11(DIN), D13(CLK)
 *   Attiny SPI PINS:     connect LCD to D4 (D/C), GND (CS), D3 (RES), D1(DIN), D2(CLK)
 *   ESP8266: connect LCD to D1(D/C), D2(CS), RX(RES), D7(DIN), D5(CLK)
 */

#include "ssd1306.h"
#include "ssd1331_api.h"
#include "nano_gfx.h"
#include <SPI.h>


#include <BLEPeripheral.h>    //bluetooth
#include <BLEUtil.h>
#include "BLESerial.h"

//BLESerial
#define BLE_REQ   10
#define BLE_RDY   2
#define BLE_RST   9
//Bluetooth - create peripheral instance, see pinout definitions above
BLESerial bleSerial(BLE_REQ, BLE_RDY, BLE_RST);


/********************************************************************************************************/
/************************ DEFINITIONS *******************************************************************/
/********************************************************************************************************/

#define HR_LED_PIN         4
#define HR_DETECTOR        29
#define TOUCH_BUTTON       30
#define VIBRATE_PIN        8
#define BATTERY_PIN        28
#define OLED_CS            15
#define OLED_RES           14
#define OLED_DC            13
#define OLED_SCL           12
#define OLED_SDA           11
#define OLED_LED_POW       16
#define OLED_IC_POW        17
#define KX126_CS           24
#define KX126_SDI          19
#define KX126_SDO          20
#define KX126_SCL          18
#define KX126_INT          23

//scroll place holder and index in array of RGB colors
int placeHolder, colorNumber;

static void hardClear()
{
    ssd1306_clearScreen();
    for (uint8_t y = 0; y < 64; y++)
    {
        ssd1331_drawLine(0,y, 95, y, RGB_COLOR8(0,0,0));
    }
}

static void hackaday(int r, int g, int b)
{
//Created using dot2pic.com
int logo[64][96]={
{0,0,0,0,0,0,0,0,0,0,0,0,0,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0,0},
{0,0,0,0,0,0,0,0,0,0,0,0,0,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0,0},
{0,0,0,0,0,0,0,0,0,0,0,0,0,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0,0},
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{0,0,0,0,0,0,0,0,0,0,0,0,0,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0,0}};

    for (uint8_t y = 0; y < 64; y++)
    {
        for (uint8_t x = 0; x < 96; x++)
        {
            if(logo[y][x]){
                ssd1331_drawLine( x, y, (x + 1), y, RGB_COLOR8(r, g, b));
            }
        }
    }
}

static void skull(int r, int g, int b, int place)
{
//Created using dot2pic.com
int skullLogo[64][96]={
{0,0,0,0,0,0,0,0,0,0,0,0,0,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0,0},
{0,0,0,0,0,0,0,0,0,0,0,0,0,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0,0},
{0,0,0,0,0,0,0,0,0,0,0,0,0,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0,0},
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{0,0,0,0,0,0,0,0,0,0,0,0,0,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0,0}};
    
    //scrolling coordinates
    uint8_t yScroll;
    
    //traverse and draw image
    for (uint8_t y = 0; y < 64; y++)
    {
        //move y coordinate by placeholder value
        yScroll = y + place;
        if(yScroll > 63) yScroll = yScroll - 64;
        
        for (uint8_t x = 0; x < 96; x++)
        {
            if(skullLogo[y][x]){
                ssd1331_drawLine( x, yScroll, (x + 1), yScroll, RGB_COLOR8(r, g, b));
            }
        }
    }
}


static void wrench(int r, int g, int b, int place)
{
//Created using dot2pic.com
int wrenchLogo[64][96]={
{0,0,0,0,0,0,0,0,0,0,0,0,0,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0,0},
{0,0,0,0,0,0,0,0,0,0,0,0,0,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0,0},
{0,0,0,0,0,0,0,0,0,0,0,0,0,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0,0},
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{0,0,0,0,0,0,0,0,0,0,0,0,0,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0,0}};

    //scrolling coordinates
    uint8_t yScroll;
    
    //traverse and draw image
    for (uint8_t y = 0; y < 64; y++)
    {
        //move y coordinate by placeholder value
        yScroll = y + place;
        if(yScroll > 63) yScroll = yScroll - 64;
        
        for (uint8_t x = 0; x < 96; x++)
        {
            if(wrenchLogo[y][x]){
                ssd1331_drawLine( x, yScroll, (x + 1), yScroll, RGB_COLOR8(r, g, b));
            }
        }
    }
}

void setup()
{
    pinMode(OLED_IC_POW, OUTPUT);  digitalWrite(OLED_IC_POW, 1);
    pinMode(OLED_LED_POW, OUTPUT);  digitalWrite(OLED_LED_POW, 0);

    Serial.begin(38400);

    //services and characteristics 
    bleSerial.setLocalName("X9nRF52832");

    //Bluetooth UART
    bleSerial.begin();
    
    // acceptable values are: -40, -30, -20, -16, -12, -8, -4, 0, 4
    int power = -4;
    sd_ble_gap_tx_power_set(power);

    //SET BLE SERIAL TRANSMIT FREQUENCY
    unsigned long millisPerTransmit = 1000; // 1HZ

    //using Bluetooth serial for debugging can be a little trickier than traditional USB UART serial connections
    bleSerial.poll();
    
    delay(100); //time to manually connect for serial debugging before rest of setup
    bleSerial.println("Setup");
    delay(50);
  
 //   ssd1306_setFixedFont(ssd1306xled_font6x8);

    ssd1331_96x64_spi_init(OLED_RES, OLED_CS, OLED_DC);  

    //start at the top
    placeHolder = 0;

}

void loop()
{
    bleSerial.poll();
    bleSerial.println("In loop");

    hardClear();

    int colors[15][3]{{0, 71, 189},
                   {2, 136, 217},
                   {7, 185, 252},
                   {0, 149, 67},
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                   {204, 114, 245}};
                 
    //set color for skull
    colorNumber = (int)random(15);

    //draw skull
    skull(colors[colorNumber][0], colors[colorNumber][1], colors[colorNumber][2], placeHolder);

    //set color for wrench
    colorNumber = (int)random(15);

    //draw wrench
    wrench(colors[colorNumber][0], colors[colorNumber][1], colors[colorNumber][2], placeHolder);

    //move scroll
    placeHolder = placeHolder + 3;
    if(placeHolder > 63) placeHolder = 0;
    delay(150);

/*
         hardClear();
         skull(0, 255, 255);
         wrench(255, 0, 255);
         delay(1000);

         hardClear();
         skull(255, 0, 255);
         wrench(255, 255, 0);
         delay(1000);

         hardClear();
         skull(255, 255, 0);
         wrench(255, 255, 255);
         delay(1000); 
         */      

}
